## Kconfig
```kconfig
menu "C-SKY Drivers"
source "addons/drivers/Kconfig"
source "addons/sound/soc/csky/Kconfig"
source "addons/sound/soc/codecs/Kconfig"
endmenu
```

## drivers/Kconfig
```kconfig
menu "Device Drivers"

source "addons/drivers/pinctrl/Kconfig"
source "addons/drivers/vpu/Kconfig"
source "addons/drivers/video/fbdev/Kconfig"
source "addons/drivers/reset/Kconfig"
source "addons/drivers/mailbox/Kconfig"
source "addons/drivers/crypto/Kconfig"
source "addons/drivers/watchdog/Kconfig"
source "addons/drivers/clk/csky/Kconfig"
source "addons/drivers/pwm/Kconfig"
source "addons/drivers/gpu/drm/csky/Kconfig"
source "addons/drivers/pci/Kconfig"
endmenu
```

## drivers/clk/csky/Kconfig
```kconfig
config CLK_CSKY
	bool "C-SKY Clock Driver"
	default n
	help
	  Support for the C-SKY SoC Family clocks.
```

## drivers/crypto/Kconfig
```kconfig
#
# CSKY CRYPTOGRAHPIC HW Engine Support
#
menuconfig CRYPTO_DEV_CSKY
    tristate "C-SKY Cryptographic Engine Support"
    depends on CSKY
    help
        This driver interface with the hardware crypto accelerator.
        Supporting SHA, CRC, AES, TripDES and RSA

if CRYPTO_DEV_CSKY

config CSKY_CRYPTO_AES
    bool "Support AES Engine Driver"

config CSKY_CRYPTO_TDES
    bool "Support TDES Engine Driver"

config CSKY_CRYPTO_CRC
    bool "Support CRC Engine Driver"

config CSKY_CRYPTO_CRC_V2
    bool "Support CRC Engine Driver version2"

config CSKY_CRYPTO_RSA
    bool "Support RSA Engine Driver"

config CSKY_CRYPTO_SHA
    bool "Support SHA Engine Driver"

endif # CRYPTO_DEV_CSKY
```

## drivers/gpu/drm/csky/Kconfig
```kconfig
#
# C-SKY DRM  driver configuration
#

choice
	prompt "DRM default mode"
	default CSKY_HDMI
	depends on OF
	help
	You can set here the default mode of DRM from
	the available modes. Don't touch if unsure.
config CSKY_HDMI
	bool "C-SKY HDMI Driver"
	depends on OF
	select HDMI
	help
	  This enables the HDMI driver for C-SKY.

config CSKY_DRM
	bool "C-SKY DRM support"
	depends on DRM
	select DRM_KMS_CMA_HELPER
	select DRM_KMS_HELPER
	select DRM_GEM_CMA_HELPER
	select DRM_FBDEV_EMULATION
	help
	  This enables the C-SKY DRM support.
endchoice

config CSKY_DRM_HDMI
	bool "C-SKY DRM HDMI driver"
	depends on CSKY_DRM
	help
	  This enables the C-SKY DRM HDMI driver.

config CSKY_LCDC_CRTC
	bool "C-SKY DRM LCDC driver"
	depends on CSKY_DRM
	help
	  This enables the C-SKY DRM LCDC driver.
```

## drivers/irqchip/Kconfig
```kconfig
config DW_APB_ICTL_DH
	bool "DH Interrupt Controller"
	select GENERIC_IRQ_CHIP
	select IRQ_DOMAIN
	default n
```

## drivers/mailbox/Kconfig
```kconfig
#
# C-SKY mailbox control drivers
#

menuconfig MAILBOX_CSKY
	bool "C-SKY hardware Mailbox Support"
	select MAILBOX

if MAILBOX_CSKY

config TTY_MAILBOX_CSKY
	bool "TTY based on C-SKY hardware Mailbox Support"
	depends on MAILBOX_CSKY && TTY

config DEBUG_MAILBOX
	bool "Debug Mailbox calls"
	depends on MAILBOX_CSKY && DEBUG_KERNEL
	help
	  Say Y here to add some extra checks and diagnostics to Mailbox calls.

endif
```

## drivers/npu/vip8000/Kconfig
```kconfig
#
# C-SKY NPU  driver configuration
#

config CSKY_NPU
	tristate "C-SKY NPU support"
	default n
	help
	  This enables the C-SKY NPU support.
```

## drivers/pci/Kconfig
```kconfig
#
# C-SKY PCI Express driver configuration
#

menu "PCI Express support"

config PCI
	bool "PCI support"
	help
	  This feature enables support for PCI bus system. If you say Y
	  here, the kernel will include drivers and infrastructure code
	  to support PCI bus devices.

config PCI_DOMAINS
	def_bool PCI

config PCI_DOMAINS_GENERIC
	def_bool PCI

config PCI_SYSCALL
	def_bool PCI

config GENERIC_PCI_IOMAP
	def_bool PCI

source "drivers/pci/Kconfig"

endmenu
```

## drivers/pinctrl/Kconfig
```kconfig
#
# C-SKY Pin control drivers
#

menu "Pin Controllers"

config DEBUG_PINCTRL
	bool "Debug PINCTRL calls"
	depends on DEBUG_KERNEL
	help
	  Say Y here to add some extra checks and diagnostics to PINCTRL calls.

config PINCTRL_CSKY
	bool "C-SKY pinctrl driver"
	depends on OF
	select PINCTRL
	select PINMUX
	select PINCONF
	select GPIOLIB

endmenu
```

## drivers/pwm/Kconfig
```kconfig
#
# C-SKY Pin control drivers
#

menu "PWM"

config PWM_CSKY
	bool "C-SKY PWM DRIVER"
	depends on OF
	select PWM
	select BACKLIGHT_PWM
endmenu
```

## drivers/reset/Kconfig
```kconfig
config RESET_CSKY
	bool "C-SKY SoCs Reset Driver"
	default n
	help
	  This enables the reset driver for C-SKY SoCs.
```

## drivers/video/fbdev/Kconfig
```kconfig
config FB_CSKY
	tristate "C-SKY framebuffer support"
	depends on FB
	select VIDEOMODE_HELPERS
	select FB_CFB_FILLRECT
	select FB_CFB_COPYAREA
	select FB_CFB_IMAGEBLIT
	default n
	help
	  Say Y if you want support for the C-SKY framebuffer.
```

## drivers/virblk/Kconfig
```kconfig
#
# C-SKY Virtual block  driver configuration
#

config CSKY_VIRBLK
	bool "C-SKY Virtual Block Device Driver"
	default n
	help
	  This enables C-SKY virtual block device driver for C-SKY.
```

## drivers/vpu/Kconfig
```kconfig
#
# C-SKY VPU driver configuration
#

menuconfig CSKY_VPU
	bool "VPU support"

if CSKY_VPU
config DEBUG_VPU
	bool "Debug VPU calls"
	depends on DEBUG_KERNEL
	help
	  Say Y here to add some extra checks and diagnostics to PINCTRL calls.

config VPU_CODA7541
	tristate "cnm coda7541 driver support"
	depends on OF
	select VIDEO_CODA

config FORCE_MAX_ZONEORDER
	int "Max kmalloc size. Set to 12 is 8MB for FHD(1080p) output frame buffer"
	default 11
endif
```

## drivers/watchdog/Kconfig
```kconfig
#
# C-SKY watchdog  driver configuration
#

config CSKY_WDT
	bool "C-SKY Watchdog Driver"
	depends on OF
	select WATCHDOG_CORE
	select WATCHDOG
	help
	  This enables the watchdog driver for C-SKY.
```

## sound/soc/codecs/Kconfig
```kconfig
config SND_CSKY_DUMMY_CODEC
	tristate "C-SKY I2S Dummy Codec Support"
	default n
	help
	  This is a dummy codec.

config SND_SOC_TLV320AIC32X4_CSKY
	tristate
	default n

config SND_SOC_TLV320AIC32X4_I2C_CSKY
	tristate "TLV320AIC32X4 audio CODECs - I2C"
	default n
	select SND_SOC_TLV320AIC32X4_CSKY
```

## sound/soc/csky/Kconfig
```kconfig
menu "C-SKY Audio support"

config SND_CSKY_I2S
	tristate "C-SKY I2S Support"
	select SND_SOC_GENERIC_DMAENGINE_PCM
	default n
	help
	  C-SKY I2S Support.

config SND_CSKY_PCM
	bool "C-SKY PCM Support"
	select SND_DMAENGINE_PCM
	default n

endmenu
```
